&soc {
	dsi_m7_38_0c_0a_video: qcom,mdss_dsi_panel_m7_38_0c_0a_fhdp_video {
		qcom,platform-reset-gpio = <&tlmm 82 0x00>; // HEX: 0x52
		qcom,mdss-brightness-max-level = <2047>;
		qcom,mdss-dsi-bl-max-level = <2047>;
		qcom,mdss-dsi-bl-min-level = <1>;
		qcom,mdss-dsi-bl-pmic-control-type = "bl_ctrl_dcs";
		qcom,panel-supply-entries = <&dsi_panel_pwr_supply_no_labibb>;
		qcom,dsi-select-clocks = "pll_byte_clk0", "pll_dsi_clk0";
		qcom,platform-en-gpio = <&pm6125_gpios 9 0x00>;
		qcom,mdss-dsi-oled-panel-video-mode;
		qcom,dsi-supported-dfps-list = <120 90 60>;
		qcom,mdss-dsi-pan-fps-update = "dfps_immediate_porch_mode_vfp";
		qcom,mdss-dsi-pan-enable-dynamic-fps;
		qcom,mdss-dsi-tx-eot-append;
		qcom,esd-err-irq-gpio = <&tlmm 33 8194>;
		qcom,mdss-brightness-init-level = <307>;
		qcom,mdss-pan-physical-height-dimension = <1546>;
		qcom,mdss-pan-physical-width-dimension = <695>;
		qcom,mdss-dsi-reset-sequence = <0 10 1 10>;
		qcom,mdss-dsi-bl-dcs-type-ss-ea;
		qcom,mdss-dsi-mdp-trigger = "none";
		qcom,mdss-dsi-dma-trigger = "trigger_sw";
		qcom,bl-update-flag = "delay_until_first_frame";
		qcom,mdss-dsi-lane-3-state;
		qcom,mdss-dsi-lane-2-state;
		qcom,mdss-dsi-lane-1-state;
		qcom,mdss-dsi-lane-0-state;
		qcom,mdss-dsi-lp11-init;
		qcom,mdss-dsi-bl-inverted-dbv;
		qcom,mdss-dsi-bllp-power-mode;
		qcom,mdss-dsi-bllp-eof-power-mode;
		qcom,mdss-dsi-traffic-mode = "burst_mode";
		qcom,mdss-dsi-border-color = <0>;
		qcom,mdss-dsi-underflow-color = <255>;
		qcom,mdss-dsi-color-order = "rgb_swap_rgb";
		qcom,mdss-dsi-bpp = <24>;
		qcom,mdss-dsi-stream = <0>;
		qcom,mdss-dsi-virtual-channel-id = <0>;
		qcom,mdss-dsi-panel-type = "dsi_video_mode";
		qcom,dsi-phy-num = <0>;
		qcom,dsi-ctrl-num = <0>;
		qcom,mdss-dsi-panel-id = <0>;
		qcom,mdss-dsi-panel-name = "m7 38 0c 0a video mode fhdp dsi panel";

		qcom,mdss-dsi-display-timings {
			timing@0 {
				qcom,default-topology-index = <0>;
				qcom,display-topology = <1 1 1>;
				qcom,mdss-dsi-panel-phy-timings = [00 24 0a 0a 1a 19 09 0a 09 02 04 00 1e 0f];
				qcom,mdss-dsc-block-prediction-enable;
				qcom,mdss-dsc-bit-per-pixel = <9>;
				qcom,mdss-dsc-bit-per-component = <9>;
				qcom,mdss-dsc-slice-per-pkt = <2>;
				qcom,mdss-dsc-slice-width = <540>;
				qcom,mdss-dsc-slice-height = <20>;
				qcom,mdss-dsc-scr-version = <0>;
				qcom,mdss-dsc-version = <17>;
				qcom,compression-mode = "dsc";
				mi,mdss-dsi-dispparam-dimming-hbmoff-command-state = "dsi_hs_mode";
				mi,mdss-dsi-dispparam-dimming-hbmon-command-state = "dsi_hs_mode";
				mi,mdss-dsi-flat-mode-off-command-state = "dsi_hs_mode";
				mi,mdss-dsi-flat-mode-on-command-state = "dsi_hs_mode";
				mi,mdss-dsi-doze-lbm-command-state = "dsi_hs_mode";
				mi,mdss-dsi-doze-hbm-command-state = "dsi_hs_mode";
				mi,mdss-dsi-hbm-off-command-state = "dsi_lp_mode";
				mi,mdss-dsi-hbm-on-command-state = "dsi_lp_mode";
				qcom,mdss-dsi-dispparam-fps-60hz-command-state = "dsi_hs_mode";
				qcom,mdss-dsi-dispparam-fps-90hz-command-state = "dsi_hs_mode";
				qcom,mdss-dsi-dispparam-fps-120hz-command-state = "dsi_hs_mode";
				qcom,mdss-dsi-pre-off-command-state = "dsi_hs_mode";
				qcom,mdss-dsi-on-command-state = "dsi_lp_mode";
				mi,mdss-dsi-flat-mode-off-command = <956366912 1008 1515862273 4194304 78643337 2973303040 1073741826 2970433793 4194304 78643203 3090743552 1073741829 3103756033 4281925888 1073741828 2952853685 956366912 4021 2182551319 2264599168 0 4287641857 0 66102693>;
				mi,mdss-dsi-flat-mode-on-command = <956366912 1008 1515862273 4194304 78643337 2973303040 1073741826 2972530945 4194304 78643203 3090743552 1073741829 3103756033 4281925888 1073741828 2952853685 956366912 4021 2182551319 2264599168 0 4287641857 0 66102693>;
				mi,mdss-dsi-doze-lbm-command = [39 01 00 00 00 00 03 51 00 18];
				mi,mdss-dsi-doze-hbm-command = [39 01 00 00 00 00 03 51 01 1b];
				mi,mdss-dsi-dispparam-dimming-hbmoff-command = [39 01 00 00 00 00 03 f0 5a 5a 39 01 00 00 00 00 04 b0 00 0d b2 39 01 00 00 00 00 02 b2 05 39 01 00 00 00 00 04 b0 00 0c b2 39 01 00 00 00 00 02 b2 30 39 01 00 00 00 00 02 f7 0b 39 01 00 00 00 00 03 f0 a5 a5];
				mi,mdss-dsi-dispparam-dimming-hbmon-command = [39 01 00 00 00 00 03 f0 5a 5a 39 01 00 00 00 00 04 b0 00 0d b2 39 01 00 00 00 00 02 b2 30 39 01 00 00 00 00 04 b0 00 0c b2 39 01 00 00 00 00 02 b2 30 39 01 00 00 00 00 02 f7 0b 39 01 00 00 00 00 03 f0 a5 a5];
				mi,mdss-dsi-hbm-off-command = [39 00 00 40 00 00 02 53 28 39 00 00 00 00 00 03 51 07 ff];
				mi,mdss-dsi-hbm-on-command = <956301376 595 3896049664 1073741827 1359478585 0 194315>;
				qcom,mdss-dsi-dispparam-fps-60hz-command = <956301376 1008 1515862272 4194304 39854393 0 194315>;
				qcom,mdss-dsi-dispparam-fps-90hz-command = <956301376 1008 1515862272 4194304 39846201 0 194315>;
				qcom,mdss-dsi-dispparam-fps-120hz-command = <956301376 1008 1515862272 4194304 39846201 0 194315>;
				qcom,mdss-dsi-pre-off-command = [05 01 00 00 14 00 02 28 00 05 01 00 00 96 00 02 10 00];
				qcom,mdss-dsi-on-command = [39 01 00 00 00 00 03 f0 5a 5a 39 01 00 00 00 00 03 f1 5a 5a 39 01 00 00 00 00 02 d0 08 39 01 00 00 00 00 04 b0 00 25 f2 39 01 00 00 00 00 02 f2 50 39 01 00 00 00 00 04 b0 00 2f f2 39 01 00 00 00 00 02 f2 27 39 01 00 00 00 00 03 f0 a5 a5 39 01 00 00 00 00 03 f1 a5 a5 05 01 00 00 20 00 02 11 00 39 01 00 00 00 00 03 f0 5a 5a 39 01 00 00 00 00 03 b2 01 31 39 01 00 00 00 00 08 df 09 30 95 43 a9 43 a9 39 01 00 00 00 00 03 f0 a5 a5 39 01 00 00 00 00 02 9d 01 39 01 00 00 00 00 5a 9e 11 00 00 89 30 80 09 60 04 38 00 28 02 1c 02 1c 02 00 02 0e 00 20 03 dd 00 07 00 0c 02 77 02 8b 18 00 10 f0 03 0c 20 00 06 0b 0b 33 0e 1c 2a 38 46 54 62 69 70 77 79 7b 7d 7e 01 02 01 00 09 40 09 be 19 fc 19 fa 19 f8 1a 38 1a 78 1a b6 2a f6 2b 34 2b 74 3b 74 6b f4 00 39 01 00 00 00 00 03 f0 5a 5a 39 01 00 00 00 00 02 60 01 39 01 00 00 00 00 02 f7 0b 39 01 00 00 00 00 03 f0 a5 a5 39 01 00 00 00 00 03 f0 5a 5a 39 01 00 00 00 00 04 b0 00 40 f2 39 01 00 00 00 00 02 f2 03 39 01 00 00 00 00 03 f0 a5 a5 39 01 00 00 00 00 03 fc 5a 5a 39 00 00 00 00 00 04 b0 00 11 fe 39 00 00 00 00 00 02 fe 00 39 01 00 00 00 00 03 fc a5 a5 39 01 00 00 00 00 04 b0 00 0d b2 39 01 00 00 00 00 02 b2 05 39 01 00 00 00 00 04 b0 00 0c b2 39 01 00 00 00 00 02 b2 30 39 01 00 00 00 00 02 f7 0b 39 01 00 00 00 00 03 f0 a5 a5 39 01 00 00 00 00 03 f0 5a 5a 39 01 00 00 00 00 03 fc 5a 5a 39 01 00 00 00 00 04 ed 01 cd 00 39 01 00 00 00 00 02 e1 93 39 01 00 00 00 00 04 b0 00 06 f4 39 01 00 00 00 00 02 f4 1f 39 01 00 00 00 00 03 f0 a5 a5 39 01 00 00 00 00 03 fc a5 a5 39 01 00 00 00 00 02 53 28 39 01 00 00 64 00 03 51 00 00 05 01 00 00 00 00 02 29 00];
				qcom,mdss-dsi-panel-framerate = <120>;
				qcom,mdss-dsi-v-pulse-width = <2>;
				qcom,mdss-dsi-v-front-porch = <20>;
				qcom,mdss-dsi-v-back-porch = <10>;
				qcom,mdss-dsi-h-sync-skew = <0>;
				qcom,mdss-dsi-h-pulse-width = <28>;
				qcom,mdss-dsi-h-back-porch = <120>;
				qcom,mdss-dsi-h-front-porch = <120>;
				qcom,mdss-dsi-panel-height = <2400>;
				qcom,mdss-dsi-panel-width = <1080>;
				qcom,mdss-dsi-video-mode;
			};
		};
	};
};
