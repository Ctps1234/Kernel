&soc {
	dsi_m7_38_0c_0b_video: qcom,mdss_dsi_panel_m7_38_0c_0b_fhdp_video {
		qcom,platform-reset-gpio = <&tlmm 82 0x00>;
		qcom,mdss-brightness-max-level = <2047>;
		qcom,mdss-dsi-bl-max-level = <2047>;
		qcom,mdss-dsi-bl-min-level = <1>;
		qcom,mdss-dsi-bl-pmic-control-type = "bl_ctrl_dcs";
		qcom,panel-supply-entries = <&dsi_panel_pwr_supply_no_labibb>;
		qcom,dsi-select-clocks = "pll_byte_clk0", "pll_dsi_clk0";
		qcom,platform-en-gpio = <&pm6125_gpios 9 0x00>;
		qcom,mdss-dsi-oled-panel-video-mode;
		qcom,dsi-supported-dfps-list = <120 90 60>;
		qcom,mdss-dsi-pan-fps-update = "dfps_immediate_porch_mode_vfp";
		qcom,mdss-dsi-pan-enable-dynamic-fps;
		qcom,mdss-dsi-tx-eot-append;
		qcom,esd-err-irq-gpio = <&tlmm 33 8194>;
		qcom,mdss-brightness-init-level = <307>;
		qcom,mdss-pan-physical-height-dimension = <1546>;
		qcom,mdss-pan-physical-width-dimension = <695>;
		qcom,mdss-dsi-reset-sequence = <0 10 1 10>;
		qcom,mdss-dsi-bl-dcs-type-ss-ea;
		qcom,mdss-dsi-mdp-trigger = "none";
		qcom,mdss-dsi-dma-trigger = "trigger_sw";
		qcom,bl-update-flag = "delay_until_first_frame";
		qcom,mdss-dsi-lane-3-state;
		qcom,mdss-dsi-lane-2-state;
		qcom,mdss-dsi-lane-1-state;
		qcom,mdss-dsi-lane-0-state;
		qcom,mdss-dsi-lp11-init;
		qcom,mdss-dsi-bl-inverted-dbv;
		qcom,mdss-dsi-bllp-power-mode;
		qcom,mdss-dsi-bllp-eof-power-mode;
		qcom,mdss-dsi-traffic-mode = "burst_mode";
		qcom,mdss-dsi-border-color = <0>;
		qcom,mdss-dsi-underflow-color = <255>;
		qcom,mdss-dsi-color-order = "rgb_swap_rgb";
		qcom,mdss-dsi-bpp = <24>;
		qcom,mdss-dsi-stream = <0>;
		qcom,mdss-dsi-virtual-channel-id = <0>;
		qcom,mdss-dsi-panel-type = "dsi_video_mode";
		qcom,dsi-phy-num = <0>;
		qcom,dsi-ctrl-num = <0>;
		qcom,mdss-dsi-panel-id = <0>;
		qcom,mdss-dsi-panel-name = "m7 38 0c 0b video mode fhdp dsi panel";

		qcom,mdss-dsi-display-timings {
			timing@0 {
				qcom,default-topology-index = <0>;
				qcom,display-topology = <1 1 1>;
				qcom,mdss-dsi-panel-phy-timings = [00 24 0a 0a 1a 19 09 0a 09 02 04 00 1e 0f];
				qcom,mdss-dsc-block-prediction-enable;
				qcom,mdss-dsc-bit-per-pixel = <8>;
				qcom,mdss-dsc-bit-per-component = <8>;
				qcom,mdss-dsc-slice-per-pkt = <2>;
				qcom,mdss-dsc-slice-width = <540>;
				qcom,mdss-dsc-slice-height = <20>;
				qcom,mdss-dsc-scr-version = <0>;
				qcom,mdss-dsc-version = <17>;
				qcom,compression-mode = "dsc";
				mi,mdss-dsi-flat-mode-off-command-state = "dsi_hs_mode";
				mi,mdss-dsi-flat-mode-on-command-state = "dsi_hs_mode";
				mi,mdss-dsi-doze-lbm-command-state = "dsi_hs_mode";
				mi,mdss-dsi-doze-hbm-command-state = "dsi_hs_mode";
				mi,mdss-dsi-hbm-off-command-state = "dsi_lp_mode";
				mi,mdss-dsi-hbm-on-command-state = "dsi_lp_mode";
				qcom,mdss-dsi-dispparam-fps-60hz-command-state = "dsi_hs_mode";
				qcom,mdss-dsi-dispparam-fps-90hz-command-state = "dsi_hs_mode";
				qcom,mdss-dsi-dispparam-fps-120hz-command-state = "dsi_hs_mode";
				qcom,mdss-dsi-off-command-state = "dsi_hs_mode";
				qcom,mdss-dsi-on-command-state = "dsi_lp_mode";
				mi,mdss-dsi-flat-mode-off-command = <956366912 1009 1515862273 4194304 95420552 2969647361 4194304 699475725 4262435200 33493647 4279435064 962267915 187575854 1044266570 1246383694 1310404570 410288128 2242817 0 66168229>;
				mi,mdss-dsi-flat-mode-on-command = [39 01 00 40 00 00 03 f1 5a 5a 39 01 00 40 00 00 05 b0 00 88 b1 01 39 01 00 40 00 00 29 b1 27 2d c5 0f 61 80 01 ff 12 26 ff 12 ff 42 44 6e 0b 0b 0b 2d 2d 2d 3c 3c 3c 47 47 47 4b 4b 4b 1b 2f da 18 64 80 00 00 22 39 01 00 40 00 00 05 b0 00 03 b8 01 39 01 00 40 00 00 05 b8 ff 8f 01 ff 39 01 00 40 00 00 05 b0 00 f8 b5 01 39 01 00 40 00 00 0f b5 e2 0e 0e 0e 82 1e 95 80 00 00 00 00 ff 90 39 01 00 00 00 00 03 f1 a5 a5];
				mi,mdss-dsi-doze-lbm-command = [39 01 00 00 00 00 03 51 00 18];
				mi,mdss-dsi-doze-hbm-command = [39 01 00 00 00 00 03 51 01 1b];
				mi,mdss-dsi-hbm-off-command = [39 00 00 40 00 00 02 53 30 39 00 00 00 00 00 02 f7 07];
				mi,mdss-dsi-hbm-on-command = <956301376 595 4030267392 1073741827 1359478585 0 194311>;
				qcom,mdss-dsi-dispparam-fps-60hz-command = <956301376 1009 1515862272 4194304 39854393 0 194311>;
				qcom,mdss-dsi-dispparam-fps-90hz-command = <956301376 1009 1515862272 4194304 39846201 0 194311>;
				qcom,mdss-dsi-dispparam-fps-120hz-command = <956301376 1009 1515862272 4194304 39846201 0 194311>;
				qcom,mdss-dsi-off-command = <83951616 184549672 83951616 2533359888>;
				qcom,mdss-dsi-on-command = <956366848 184550303 1515848961 5120 34668601 16777216 258394 1513685248 3 2986422329 16777216 258469 2771976448 2 2634103041 0 1520308480 8990848 157287480 2621980 35389952 34471968 64815111 787063 42670080 284164876 536872459 187895324 708331092 1651077239 2038136190 16908544 155191742 435952122 435690040 444078774 720775988 729037684 1811152953 16777216 389466 1515870777 16777216 372736 2648703289 16777216 188416 956366848 1521 2779096485 956366848 1009 1515862273 0 39846201 16777216 194311 956366848 1009 2779068673 0 99703386 1515862273 0 95420466 4127275265 0 116794368 419430457 16777216 389541 2779096377 16777216 258394 1513685248 5 2952793522 20513024 2 2988456193 0 95420428 2986424577 0 45232185 16777216 258469 2771976448 5 4049230426 1513685248 5 2952793038 20513024 2 3457235201 0 95420424 3925948673 0 65730185 956366848 1456 715265 956366848 1258 1426129977 16777216 372736 233439545 16777216 256767 4281925888 5 2952819937 20513024 2 3779016961 0 95420432 3925948673 0 48890169 16777216 389541 2779096377 16777216 152368 956366848 849 14593 25856 49743621 16777216 141568>;
				qcom,mdss-dsi-panel-framerate = <120>;
				qcom,mdss-dsi-v-pulse-width = <2>;
				qcom,mdss-dsi-v-front-porch = <20>;
				qcom,mdss-dsi-v-back-porch = <10>;
				qcom,mdss-dsi-h-sync-skew = <0>;
				qcom,mdss-dsi-h-pulse-width = <28>;
				qcom,mdss-dsi-h-back-porch = <120>;
				qcom,mdss-dsi-h-front-porch = <120>;
				qcom,mdss-dsi-panel-height = <2400>;
				qcom,mdss-dsi-panel-width = <1080>;
				qcom,mdss-dsi-video-mode;
			};
		};
	};
};
