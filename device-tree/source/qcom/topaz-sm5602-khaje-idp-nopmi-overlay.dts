/dts-v1/;
/plugin/;

#include <dt-bindings/interrupt-controller/arm-gic.h>
#include "khaje-idp-nopmi.dtsi"
#include "topaz-khaje-idp-nopmi.dtsi"

/ {
	model = "Qualcomm Technologies, Inc. KHAJE IDP nopmi topaz";
	compatible = "qcom,khaje-idp", "qcom,khaje", "qcom,idp";
	qcom,msm-id = <0x24A 0x10000>;
	qcom,board-id = <0x30022 0x00>;
	qcom,pmic-id = <0x2D 0x00 0x00 0x00>;
};
